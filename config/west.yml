## config/west.yml
```yaml
manifest:
  defaults:
    remote: sirncn
  remotes:
    - name: sirncn
      url-base: https://github.com/sirncn
    - name: zmkfirmware
      url-base: https://github.com/zmkfirmware
    - name: dhruvinsh
      url-base: https://github.com/dhruvinsh
  projects:
    - name: zmk
      remote: zmkfirmware
      import: app/west.yml
    - name: zmk-tri-state
      remote: dhruvinsh
      revision: main
      clone-depth: 1
      path: .west/repos/zmk-tri-state
    - name: zephyr
      remote: zmkfirmware
      revision: v3.5.0+zmk-fixes
      clone-depth: 1
      import:
        name-allowlist:
          - cmsis
          - hal_nordic
          - hal_rpi_pico
          - hal_stm32
          - lvgl
          - tinycrypt
  self:
    path: config
```
