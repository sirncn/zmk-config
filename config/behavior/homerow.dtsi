/ {
  behaviors {
    // classic home row mode
    HOLD_TAP(hml, home_row_mod_left, &kp, &kp, KEYS_R THUMBS,
      require-prior-idle-ms = <100>;
    );
    HOLD_TAP(hmr, home_row_mod_right, &kp, &kp, KEYS_L THUMBS,
      require-prior-idle-ms = <100>;
    );

		// home row mode with shift
    HOLD_TAP(hsl, home_row_mod_for_shift_left, &kp, &kp, KEYS_R THUMBS);
    HOLD_TAP(hsr, home_row_mod_for_shift_right, &kp, &kp, KEYS_L THUMBS);

    // home row mode with layers
    HOLD_TAP(hll, home_row_layer_mod_left, &mo, &kp, KEYS_R THUMBS LB3 LB2 LB1);
    HOLD_TAP(hlr, home_row_layer_mod_right, &mo, &kp, KEYS_L THUMBS RB3 RB2 RB1);
  };
};
