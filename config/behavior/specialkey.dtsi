#define __NUM_REVERSE(_number, _symbol)  SHIFT_KEY(kp_r ## _number, &kp _symbol, &kp _number)

/ {
  behaviors {
    // `BACKSPACE` behaves like `DEL` when holding shift down.
    SHIFT_KEY(kp_bspcdel, &kp BACKSPACE, &kp DELETE);

    // make a "symbol" with tap and a "number" with a shift-tap.
    // generate a behavior named `kp_rN<x>`
    __NUM_REVERSE(N1, EXCLAMATION);
    __NUM_REVERSE(N2, AT);
    __NUM_REVERSE(N3, HASH);
    __NUM_REVERSE(N4, DOLLAR);
    __NUM_REVERSE(N5, PERCENT);
    __NUM_REVERSE(N6, CARET);
    __NUM_REVERSE(N7, AMPERSAND);
    __NUM_REVERSE(N8, ASTERISK);
    __NUM_REVERSE(N9, LEFT_PARENTHESIS);
    __NUM_REVERSE(N0, RIGHT_PARENTHESIS);
};
